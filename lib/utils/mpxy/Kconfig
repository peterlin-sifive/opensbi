## lib/utils/mpxy/Kconfig
```kconfig
# SPDX-License-Identifier: BSD-2-Clause

menu "MPXY Device Support"

config FDT_MPXY
	bool "FDT based MPXY drivers"
	depends on FDT
	default n

config FDT_MPXY_RPMI_MBOX
	bool "MPXY drivers as RPMI mailbox client"
	depends on FDT_MAILBOX && FDT_MPXY
	default n

if FDT_MPXY_RPMI_MBOX

config FDT_MPXY_RPMI_CLOCK
	bool "MPXY driver for RPMI clock service group"
	default n

config FDT_MPXY_RPMI_SYSMSI
	bool "MPXY driver for RPMI system MSI service group"
	default n

config FDT_MPXY_RPMI_VOLTAGE
	bool "MPXY driver for RPMI voltage service group"
	default n

config FDT_MPXY_RPMI_DEVICE_POWER
	bool "MPXY driver for RPMI device power service group"
	default n

config FDT_MPXY_RPMI_PERFORMANCE
	bool "MPXY driver for RPMI performance service group"
	default n

config FDT_MPXY_RPMI_MM
	bool "MPXY driver for RPMI MM service group"
	default n

endif

config FDT_MPXY_RPMI_REQFWD
	bool "MPXY driver for RPMI Request Forward service group"
	depends on FDT_MPXY
	default n

config FDT_MPXY_RPMI_TEE
	bool "MPXY driver for RPMI TEE service group"
	depends on FDT_MPXY
	select FDT_TEE
	default n

if FDT_MPXY_RPMI_TEE

menu "TEE Dispatcher Support"

config FDT_TEE
	bool "FDT based TEE dispatcher support"
	depends on FDT
	default y

config FDT_TEE_OPTEE
	bool "OP-TEE dispatcher support"
	depends on FDT_TEE
	depends on FDT_MPXY_RPMI_REQFWD
	default n

endmenu

endif

endmenu
```
